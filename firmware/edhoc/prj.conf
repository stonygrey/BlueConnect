## CMakeLists.txt
```
# Copyright © 2026 Stony Grey LLC.
# SPDX-License-Identifier: MIT
# EDHOC firmware: peripheral_uart (NCS) chassis plus the shared Verdigris
# GATT service (firmware/common) with an EDHOC responder (edhoc.c) behind it,
# switchable via CONFIG_VERDIGRIS.
cmake_minimum_required(VERSION 3.20.0)

find_package(Zephyr REQUIRED HINTS $ENV{ZEPHYR_BASE})
project(edhoc_firmware)

# The proto lives at the repo root (single source of truth with the C# side);
# nanopb wants it and its .options side by side under the app tree.
configure_file(${CMAKE_CURRENT_SOURCE_DIR}/../../proto/verdigris.proto
               ${CMAKE_CURRENT_SOURCE_DIR}/src/verdigris.proto COPYONLY)
configure_file(${CMAKE_CURRENT_SOURCE_DIR}/../../proto/verdigris.options
               ${CMAKE_CURRENT_SOURCE_DIR}/src/verdigris.options COPYONLY)

if(CONFIG_VERDIGRIS)
  list(APPEND CMAKE_MODULE_PATH ${ZEPHYR_BASE}/modules/nanopb)
  include(nanopb)
  zephyr_nanopb_sources(app src/verdigris.proto)
  # The Verdigris service (GATT table, dispatcher, framing) is shared with
  # firmware/noise and firmware/pake; this app supplies the EDHOC responder
  # behind link_iface.h.
  target_include_directories(app PRIVATE ${CMAKE_CURRENT_SOURCE_DIR}/../common/src)
  target_sources(app PRIVATE
    ${CMAKE_CURRENT_SOURCE_DIR}/../common/src/verdigris.c
    ${CMAKE_CURRENT_SOURCE_DIR}/../common/src/segment.c
    src/edhoc.c
    src/cred_ui.c)
  # ecdh_x decompresses x-only peer points via ocrypto. On SoCs whose PSA
  # driver is CRACEN (nRF54L) the Oberon library is not already in the link,
  # so link the standalone nrf_oberon (CONFIG_NRF_OBERON in prj.conf).
  target_link_libraries(app PRIVATE nrfxlib_crypto)
endif()

# The peripheral_uart chassis is shared; src/main.c is the app-init shim.
target_sources(app PRIVATE
  ${CMAKE_CURRENT_SOURCE_DIR}/../common/src/app_main.c
  src/main.c)
```

## Kconfig
```
#
# Copyright (c) 2018 Nordic Semiconductor
# Modifications Copyright © 2026 Stony Grey LLC.
#
# SPDX-License-Identifier: LicenseRef-Nordic-5-Clause
#
#
# Forked from NCS peripheral_uart; adds CONFIG_VERDIGRIS (EDHOC app).
#

source "Kconfig.zephyr"

menu "Verdigris firmware"

config BT_NUS
	default y if !VERDIGRIS

config VERDIGRIS
	bool "Verdigris binary command/response protocol over NUS"
	default y
	select NANOPB
	help
	  When enabled, bytes received on the NUS RX characteristic are parsed
	  as length-prefixed protobuf Requests and answered with Responses on
	  the TX characteristic. When disabled, the firmware behaves exactly
	  like the stock peripheral_uart sample (BLE<->UART bridge).

config BT_NUS_THREAD_STACK_SIZE
	int "Thread stack size"
	default 1024
	help
	  Stack size used in each of the two threads

config BT_NUS_UART_BUFFER_SIZE
	int "UART payload buffer element size"
	default 40
	help
	  Size of the payload buffer in each RX and TX FIFO element

config BT_NUS_SECURITY_ENABLED
	bool "Security"
	default n if VERDIGRIS
	default y
	select BT_SMP
	help
	  Enable Bluetooth LE security (SMP) for the UART service. Off
	  under Verdigris: link security is EDHOC on the Verdigris
	  characteristics, which do not require ATT encryption. Leaving
	  the leftover NUS pairing UI enabled stole the same DK buttons
	  and could occupy the single BLE bond slot.

config BT_NUS_UART_RX_WAIT_TIME
	int "Timeout for UART RX complete event"
	default 50000
	help
	  Wait for RX complete event time in microseconds

config SETTINGS
	default y

config ZMS
	default y if (SOC_FLASH_NRF_RRAM || SOC_FLASH_NRF_MRAM)

config NVS
	default y if !(SOC_FLASH_NRF_RRAM || SOC_FLASH_NRF_MRAM)

endmenu
```

## prj.conf
```kconfig
#
# Copyright (c) 2018 Nordic Semiconductor
# Modifications Copyright © 2026 Stony Grey LLC.
#
# SPDX-License-Identifier: LicenseRef-Nordic-5-Clause
#
# Forked from NCS peripheral_uart prj.conf; Verdigris/EDHOC additions at the
# bottom.

# Enable the UART driver
CONFIG_UART_ASYNC_API=y
CONFIG_NRFX_UARTE=y
CONFIG_SERIAL=y

CONFIG_GPIO=y

# Make sure printk is printing to the UART console
CONFIG_CONSOLE=y
CONFIG_UART_CONSOLE=y

CONFIG_HEAP_MEM_POOL_SIZE=2048

CONFIG_BT=y
CONFIG_BT_PERIPHERAL=y
CONFIG_BT_DEVICE_NAME="Nordic_UART_Service"
CONFIG_BT_MAX_CONN=1
CONFIG_BT_MAX_PAIRED=1


# Enable bonding + custom NVS (ek/*). Explicit so a reset cannot drop the
# handler backend.
CONFIG_BT_SETTINGS=y
CONFIG_SETTINGS=y
CONFIG_SETTINGS_NVS=y
CONFIG_FLASH=y
CONFIG_FLASH_PAGE_LAYOUT=y
CONFIG_FLASH_MAP=y

# Enable DK LED and Buttons library
CONFIG_DK_LIBRARY=y

CONFIG_SYSTEM_WORKQUEUE_STACK_SIZE=2048
# Config logger
CONFIG_LOG=y
CONFIG_USE_SEGGER_RTT=y
CONFIG_LOG_BACKEND_RTT=y
CONFIG_LOG_BACKEND_UART=n
CONFIG_LOG_PRINTK=n

CONFIG_ASSERT=y

# --- Verdigris additions ---

# Large ATT MTU + data length extension so multi-MTU frames move quickly.
CONFIG_BT_L2CAP_TX_MTU=247
CONFIG_BT_BUF_ACL_RX_SIZE=251
CONFIG_BT_BUF_ACL_TX_SIZE=251
CONFIG_BT_CTLR_DATA_LENGTH_MAX=251

# Floating point math (sqrt) on doubles.
CONFIG_FPU=y

# Accept ATT long (queued) writes from centrals that exceed the MTU per write
# (iOS/Windows may segment large characteristic writes this way).
CONFIG_BT_ATT_PREPARE_COUNT=8

# Advertised name is generated at boot ("Verdigris NNNN").
CONFIG_BT_DEVICE_NAME_DYNAMIC=y

# EDHOC is the link security. Do not also run leftover NUS SMP pairing
# (it is not required by the GATT permissions and used the same buttons).
CONFIG_BT_NUS_SECURITY_ENABLED=n

# --- Link security (EDHOC RFC 9528, method 3, cipher suite 2, PSA crypto) ---
# P-256 ECDH, SHA-256, and AES-CCM-16-64-128 run in the Oberon software
# driver. HMAC covers both EDHOC_Extract and the hand-rolled HKDF-Expand
# (EDHOC_KDF), so no PSA HKDF symbol is needed.
CONFIG_PSA_CRYPTO=y
CONFIG_PSA_WANT_ALG_SHA_256=y
CONFIG_PSA_WANT_ALG_HMAC=y
CONFIG_PSA_WANT_KEY_TYPE_HMAC=y
CONFIG_PSA_WANT_ALG_ECDH=y
CONFIG_PSA_WANT_ECC_SECP_R1_256=y
CONFIG_PSA_WANT_KEY_TYPE_ECC_KEY_PAIR_IMPORT=y
CONFIG_PSA_WANT_KEY_TYPE_ECC_KEY_PAIR_GENERATE=y
CONFIG_PSA_WANT_KEY_TYPE_ECC_KEY_PAIR_EXPORT=y
CONFIG_PSA_WANT_KEY_TYPE_ECC_PUBLIC_KEY=y
# EDHOC message_3 sealing: AES-CCM with the suite's 8-byte tag.
CONFIG_PSA_WANT_ALG_CCM=y
CONFIG_PSA_WANT_AES_KEY_SIZE_128=y
# Transport frames: AES-256-GCM, same discipline as the other links.
CONFIG_PSA_WANT_ALG_GCM=y
CONFIG_PSA_WANT_KEY_TYPE_AES=y
CONFIG_PSA_WANT_AES_KEY_SIZE_256=y
CONFIG_MBEDTLS_HEAP_SIZE=16384

# Serial shell (ek info/keygen/cred/set-peer/clear) on the J-Link VCOM port.
# Logs stay on RTT, so the shell owns the UART. The hex CCS argument needs a
# longer command buffer than the default.
CONFIG_SHELL=y
CONFIG_SHELL_CMD_BUFF_SIZE=512
# Headroom for long hex arguments (CCS / verifier). Note this alone does
# not survive an unpaced burst — the J-Link CDC-to-UART bridge drops
# characters upstream of the chip — so the host tool paces its writes;
# that pacing is the operative fix.
CONFIG_SHELL_BACKEND_SERIAL_RX_RING_BUFFER_SIZE=1024

# The x-only decompression path (ecdh_x) uses ocrypto directly. On nRF54L
# the PSA driver is CRACEN, which does not carry the ocrypto headers, so
# pull in the standalone Oberon library for it explicitly.
CONFIG_NRF_OBERON=y
```

## src/main.c
```c
/* Copyright © 2026 Stony Grey LLC.
 * SPDX-License-Identifier: MIT
 */

/* The peripheral_uart chassis is shared across every Verdigris app and lives
 * in firmware/common/src/app_main.c; this shim supplies the app-specific
 * link initialization it calls after settings_load().
 */

#ifdef CONFIG_VERDIGRIS
#include "link_iface.h"
#include "edhoc.h"
#include "cred_ui.h"

void link_app_init(void)
{
	edhoc_init();
	cred_ui_init();
}
#endif
```

## src/cred_ui.c
```c
/* Copyright © 2026 Stony Grey LLC.
 * SPDX-License-Identifier: MIT
 */

#include "cred_ui.h"
#include "verdigris.h"
#include "edhoc.h"

#include <stdlib.h>
#include <string.h>

#include <zephyr/kernel.h>
#include <zephyr/bluetooth/bluetooth.h>
#include <zephyr/logging/log.h>
#include <zephyr/shell/shell.h>

#include <dk_buttons_and_leds.h>

LOG_MODULE_REGISTER(cred_ui);

#define CLEAR_HOLD_MS 5000
#define WIPE_HOLD_MS 5000
#define SLOT_LED_LO DK_LED3
#define SLOT_LED_HI DK_LED4
#define PAIR_BTN_LO_MSK DK_BTN3_MSK
#define PAIR_BTN_HI_MSK DK_BTN4_MSK
#define CLEAR_BTN_MSK DK_BTN4_MSK

static int64_t button_down_at;
static bool chord_armed;

static void show_slots(void)
{
	dk_set_led(SLOT_LED_LO, edhoc_has_peer(LINK_PRIV_LOW));
	dk_set_led(SLOT_LED_HI, edhoc_has_peer(LINK_PRIV_HIGH));
}

/* The wipe salute: LEDs 2 and 3 (dk indices 3/4) flash together three times so a factory
 * wipe is unmistakable (LED1/LED2 belong to the app state and the
 * connection; they stay out of it).
 */
#define SALUTE_TOGGLES 6
#define SALUTE_STEP_MS 150

static int salute_step;

static void salute_set(bool on)
{
	dk_set_led(DK_LED3, on);
	dk_set_led(DK_LED4, on);
}

static void salute_tick(struct k_timer *timer)
{
	if (salute_step >= SALUTE_TOGGLES) {
		k_timer_stop(timer);
		salute_set(false);
		show_slots();
		return;
	}

	salute_set((salute_step % 2) == 0);
	salute_step++;
}

static K_TIMER_DEFINE(salute_timer, salute_tick, NULL);

static void salute_start(void)
{
	salute_step = 0;
	k_timer_start(&salute_timer, K_NO_WAIT, K_MSEC(SALUTE_STEP_MS));
}

/* ---- Pairing window (same LED/button grammar as the Noise app) ---- */

void cred_ui_window_begin(enum link_privilege privilege)
{
	ARG_UNUSED(privilege);
	dk_set_led(SLOT_LED_LO, false);
	dk_set_led(SLOT_LED_HI, false);
}

void cred_ui_window_tick(int slice, bool high)
{
	int led = high ? SLOT_LED_HI : SLOT_LED_LO;

	dk_set_led(led, high ? (slice % 2) == 0 : (slice % 4) < 2);
}

void cred_ui_window_end(void)
{
	show_slots();
}

/* Factory wipe: slots, locks, the device key, and the rate-limit counter
 * all fall; a fresh key is generated immediately so the link keeps
 * working. Every printed QR is orphaned and every stored phone credential
 * stops verifying — that is the point of the gesture.
 */
static void factory_wipe(void)
{
	link_reset();
	edhoc_clear_peers();
	(void)edhoc_keygen(true);
	edhoc_forget_failures();
	verdigris_wipe_foreign_credentials("ek/");
	salute_start();
}

static void wipe_fire(struct k_work *work)
{
	ARG_UNUSED(work);
	factory_wipe();
}

static K_WORK_DELAYABLE_DEFINE(wipe_work, wipe_fire);

static void button_changed(uint32_t button_state, uint32_t has_changed)
{
	enum link_privilege needed = edhoc_armed();
	uint32_t chord = PAIR_BTN_LO_MSK | PAIR_BTN_HI_MSK;

	/* Buttons 2+3 (dk indices 3/4) held together (no window armed) = factory wipe, fired
	 * automatically at the 5 s mark while still held — the salute starting
	 * is the cue to let go; no counting. Releasing early cancels. The
	 * chord owns both buttons and swallows its own release.
	 */
	if ((button_state & chord) == chord) {
		if (needed == LINK_PRIV_NONE && !chord_armed) {
			chord_armed = true;
			k_work_schedule(&wipe_work, K_MSEC(WIPE_HOLD_MS));
		}
		button_down_at = 0;
		return;
	}
	if (chord_armed) {
		chord_armed = false;
		k_work_cancel_delayable(&wipe_work);
		return; /* swallow the chord's release */
	}

	if (has_changed & PAIR_BTN_LO_MSK) {
		if (button_state & PAIR_BTN_LO_MSK) {
			edhoc_confirm(LINK_PRIV_LOW);
		}
	}

	if (has_changed & PAIR_BTN_HI_MSK) {
		if (button_state & PAIR_BTN_HI_MSK) {
			if (needed != LINK_PRIV_NONE) {
				/* A pairing window owns this press; do not
				 * treat a later release as a clear hold.
				 */
				button_down_at = 0;
				edhoc_confirm(LINK_PRIV_HIGH);
			} else {
				button_down_at = k_uptime_get();
			}
		} else if (needed == LINK_PRIV_NONE && button_down_at &&
			   (k_uptime_get() - button_down_at) >= CLEAR_HOLD_MS) {
			edhoc_clear_peers();
			show_slots();
			button_down_at = 0;
		} else {
			button_down_at = 0;
		}
	}
}

void cred_ui_init(void)
{
	dk_buttons_init(button_changed);
	show_slots();
}

static enum link_privilege parse_tier(const char *arg)
{
	if (strcmp(arg, "lo") == 0 || strcmp(arg, "low") == 0) {
		return LINK_PRIV_LOW;
	}
	if (strcmp(arg, "hi") == 0 || strcmp(arg, "high") == 0) {
		return LINK_PRIV_HIGH;
	}
	return LINK_PRIV_NONE;
}

static int hex_nibble(char c)
{
	if (c >= '0' && c <= '9') {
		return c - '0';
	}
	if (c >= 'a' && c <= 'f') {
		return c - 'a' + 10;
	}
	if (c >= 'A' && c <= 'F') {
		return c - 'A' + 10;
	}
	return -1;
}

static bool parse_hex(const char *hex, uint8_t *out, size_t out_cap, size_t *out_len)
{
	size_t chars = strlen(hex);

	if (chars == 0 || chars % 2 != 0 || chars / 2 > out_cap) {
		return false;
	}

	for (size_t i = 0; i < chars / 2; i++) {
		int hi = hex_nibble(hex[2 * i]);
		int lo = hex_nibble(hex[2 * i + 1]);

		if (hi < 0 || lo < 0) {
			return false;
		}

		out[i] = (uint8_t)((hi << 4) | lo);
	}

	*out_len = chars / 2;
	return true;
}

static void print_hex(const struct shell *sh, const uint8_t *data, size_t len)
{
	static char line[2 * EDHOC_CRED_MAX + 1];

	for (size_t i = 0; i < len && i < EDHOC_CRED_MAX; i++) {
		line[2 * i] = "0123456789abcdef"[data[i] >> 4];
		line[2 * i + 1] = "0123456789abcdef"[data[i] & 0x0f];
	}
	line[2 * MIN(len, (size_t)EDHOC_CRED_MAX)] = '\0';
	shell_print(sh, "%s", line);
}

static int cmd_ek_info(const struct shell *sh, size_t argc, char **argv)
{
	ARG_UNUSED(argc);
	ARG_UNUSED(argv);

	size_t cred_len = 0;
	const uint8_t *cred = edhoc_device_cred(&cred_len);

	shell_print(sh, "name: %s", bt_get_name());
	shell_print(sh, "device key: %s", edhoc_have_key() ? "present" : "missing");
	if (cred) {
		shell_print(sh, "device cred: %u-byte CCS, kid 0x%02x",
			    (unsigned)cred_len, EDHOC_KID_DEVICE);
	}
	shell_print(sh, "low slot: %s",
		    !edhoc_has_peer(LINK_PRIV_LOW) ? "empty"
		    : edhoc_slot_locked(LINK_PRIV_LOW) ? "provisioned (usb)"
						       : "pinned (ceremony)");
	shell_print(sh, "high slot: %s",
		    !edhoc_has_peer(LINK_PRIV_HIGH) ? "empty"
		    : edhoc_slot_locked(LINK_PRIV_HIGH) ? "provisioned (usb)"
							: "pinned (ceremony)");
	shell_print(sh, "session: %s", edhoc_session_active() ? "secure" : "none");
	return 0;
}

static int cmd_ek_keygen(const struct shell *sh, size_t argc, char **argv)
{
	bool force = argc == 2 && strcmp(argv[1], "force") == 0;

	if (!edhoc_keygen(force)) {
		shell_error(sh, edhoc_have_key()
			    ? "a key exists; `vg keygen force` rotates it "
			      "(orphans every printed QR)"
			    : "key generation failed");
		return -EINVAL;
	}

	shell_print(sh, "generated; read the credential back with `vg cred`");
	return 0;
}

static int cmd_ek_cred(const struct shell *sh, size_t argc, char **argv)
{
	ARG_UNUSED(argc);
	ARG_UNUSED(argv);

	size_t len = 0;
	const uint8_t *cred = edhoc_device_cred(&len);

	if (!cred) {
		shell_error(sh, "no device credential; run `vg keygen`");
		return -ENOENT;
	}

	print_hex(sh, cred, len);
	return 0;
}

static int cmd_ek_set_peer(const struct shell *sh, size_t argc, char **argv)
{
	static uint8_t ccs[EDHOC_CRED_MAX];
	enum link_privilege tier;
	size_t len;

	if (argc != 3) {
		shell_error(sh, "usage: vg set <lo|hi> <hex CCS>");
		return -EINVAL;
	}

	tier = parse_tier(argv[1]);
	if (tier == LINK_PRIV_NONE) {
		shell_error(sh, "tier must be lo or hi");
		return -EINVAL;
	}

	if (!parse_hex(argv[2], ccs, sizeof(ccs), &len)) {
		shell_error(sh, "expected up to %u hex characters, an even count",
			    2 * EDHOC_CRED_MAX);
		return -EINVAL;
	}

	if (!edhoc_set_peer(tier, ccs, len)) {
		shell_error(sh, "credential rejected");
		return -EINVAL;
	}

	show_slots();
	shell_print(sh, "provisioned %s", argv[1]);
	return 0;
}

static int cmd_ek_confirm(const struct shell *sh, size_t argc, char **argv)
{
	ARG_UNUSED(argc);
	ARG_UNUSED(argv);

	enum link_privilege armed = edhoc_armed();

	if (armed == LINK_PRIV_NONE) {
		shell_print(sh, "no pairing in progress");
		return 0;
	}

	edhoc_confirm(armed);
	shell_print(sh, "confirmed");
	return 0;
}

static int cmd_ek_clear(const struct shell *sh, size_t argc, char **argv)
{
	if (argc == 2 && strcmp(argv[1], "all") != 0) {
		enum link_privilege tier = parse_tier(argv[1]);

		if (tier == LINK_PRIV_NONE) {
			shell_error(sh, "usage: vg clear [lo|hi|all]");
			return -EINVAL;
		}

		edhoc_clear_peer(tier);
	} else {
		edhoc_clear_peers();
	}

	show_slots();
	shell_print(sh, "cleared");
	return 0;
}

static int cmd_ek_wipe(const struct shell *sh, size_t argc, char **argv)
{
	ARG_UNUSED(argc);
	ARG_UNUSED(argv);

	factory_wipe();
	shell_print(sh, "wiped every scheme's stored keys; a fresh key was generated");
	return 0;
}

SHELL_STATIC_SUBCMD_SET_CREATE(vg_cmds,
	SHELL_CMD(info, NULL, "Show credential slots and session state", cmd_ek_info),
	SHELL_CMD(keygen, NULL, "Generate the device key: vg keygen [force]", cmd_ek_keygen),
	SHELL_CMD(cred, NULL, "Print the device CCS as hex", cmd_ek_cred),
	SHELL_CMD(set, NULL, "Provision a CCS over USB (locks the slot): vg set <lo|hi> <hex>",
		  cmd_ek_set_peer),
	SHELL_CMD(confirm, NULL, "Confirm an in-progress pairing ceremony", cmd_ek_confirm),
	SHELL_CMD(clear, NULL, "Clear credential slot(s) and locks: vg clear [lo|hi|all]",
		  cmd_ek_clear),
	SHELL_CMD(wipe, NULL, "Factory wipe of every scheme's stored keys "
		  "(same as holding Buttons 2+3 for 5 s)", cmd_ek_wipe),
	SHELL_SUBCMD_SET_END);

SHELL_CMD_REGISTER(vg, &vg_cmds, "Verdigris link security", NULL);
```

## src/cred_ui.h
```c
/* Copyright © 2026 Stony Grey LLC.
 * SPDX-License-Identifier: MIT
 */

/* Provisioning UI for the EDHOC firmware: the `ek` serial shell (USB access
 * is the possession proof), slot LEDs, the clear-all button, and the
 * pairing-window LED/button ceremony for enrolled candidates.
 */
#ifndef CRED_UI_H_
#define CRED_UI_H_

#include "link_iface.h"

void cred_ui_init(void);

/* Pairing-window display, driven from link_pair's wait loop: begin blanks
 * the slot LEDs, tick blinks the armed tier's LED, end restores the slot
 * display.
 */
void cred_ui_window_begin(enum link_privilege privilege);
void cred_ui_window_tick(int slice, bool high);
void cred_ui_window_end(void);

#endif /* CRED_UI_H_ */
```

## src/edhoc.h
```c
/* Copyright © 2026 Stony Grey LLC.
 * SPDX-License-Identifier: MIT
 */

/* BlueConnect EDHOC link: RFC 9528 responder (method 3 static-static DH,
 * cipher suite 2) over PSA crypto, per-slot pinned initiator credentials,
 * privilege by kid. The dispatcher-facing contract is link_iface.h; this
 * header adds the EDHOC app's provisioning API. Credentials are CWT Claims
 * Sets (CCS) stored verbatim — they participate byte-exactly in the
 * transcript MACs, so they are never re-encoded. Framing and the Verdigris
 * command set live in firmware/common; LEDs/shell are cred_ui.
 */
#ifndef EDHOC_H_
#define EDHOC_H_

#include "link_iface.h"

/* Largest CCS blob a slot accepts (the standard provisioning credential is
 * 83 bytes: cnf/COSE_Key with kid, x, y and no subject).
 */
#define EDHOC_CRED_MAX 192

/* Initiator kids name the privilege slots; the device's own kid is fixed.
 * Twin of host BlueConnectEdhoc.
 */
#define EDHOC_KID_LOW 0x01
#define EDHOC_KID_HIGH 0x02
#define EDHOC_KID_DEVICE 0x0A

void edhoc_init(void);

bool edhoc_session_active(void);

/* The device's own credential: private key auto-generated at first boot,
 * CCS persisted verbatim (ek/key, ek/cred). keygen(force) rotates the key —
 * which orphans every previously printed QR.
 */
bool edhoc_have_key(void);
bool edhoc_keygen(bool force);
const uint8_t *edhoc_device_cred(size_t *len);

/* Per-slot pinned initiator credentials (ek/peer_lo, ek/peer_hi), each with
 * a provenance flag (ek/lock_lo, ek/lock_hi). `vg set` over the USB
 * shell locks the slot: no pairing ceremony may replace it and no remote
 * unpair may clear it — only `vg clear` (possession proof). A ceremony-made
 * pin is unlocked: a later matching ceremony may replace it, and the phone
 * may unpair it remotely.
 */
bool edhoc_has_peer(enum link_privilege privilege);
bool edhoc_slot_locked(enum link_privilege privilege);
bool edhoc_set_peer(enum link_privilege privilege, const uint8_t *ccs, size_t len);
void edhoc_clear_peer(enum link_privilege privilege);
void edhoc_clear_peers(void);

/* Factory-wipe support: zero the persisted rate-limit counter (ek/fails). */
void edhoc_forget_failures(void);

/* Pairing-ceremony confirmation, driven by cred_ui (buttons and the
 * `vg confirm` shell command). armed() reports the privilege of the open
 * window (NONE = no window); confirm(pressed) resolves it.
 */
enum link_privilege edhoc_armed(void);
void edhoc_confirm(enum link_privilege pressed);

#endif /* EDHOC_H_ */
```
