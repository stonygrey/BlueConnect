## CMakeLists.txt
```
# Copyright © 2026 Stony Grey LLC.
# SPDX-License-Identifier: MIT
# Verdigris firmware: peripheral_uart (NCS) chassis plus the Verdigris
# GATT service (segment + link + app API), switchable via CONFIG_VERDIGRIS.
cmake_minimum_required(VERSION 3.20.0)

find_package(Zephyr REQUIRED HINTS $ENV{ZEPHYR_BASE})
project(verdigris_firmware)

# The proto is at the repo root (single source of truth with the C# side);
# nanopb requires it and its .options side by side under the app tree.
configure_file(${CMAKE_CURRENT_SOURCE_DIR}/../../proto/verdigris.proto
               ${CMAKE_CURRENT_SOURCE_DIR}/src/verdigris.proto COPYONLY)
configure_file(${CMAKE_CURRENT_SOURCE_DIR}/../../proto/verdigris.options
               ${CMAKE_CURRENT_SOURCE_DIR}/src/verdigris.options COPYONLY)

if(CONFIG_VERDIGRIS)
  list(APPEND CMAKE_MODULE_PATH ${ZEPHYR_BASE}/modules/nanopb)
  include(nanopb)
  zephyr_nanopb_sources(app src/verdigris.proto)
  # The Verdigris service (GATT table, dispatcher, framing) comes from
  # firmware/common; this app supplies the Noise link behind link_iface.h.
  target_include_directories(app PRIVATE ${CMAKE_CURRENT_SOURCE_DIR}/../common/src)
  target_sources(app PRIVATE
    ${CMAKE_CURRENT_SOURCE_DIR}/../common/src/verdigris.c
    ${CMAKE_CURRENT_SOURCE_DIR}/../common/src/segment.c
    src/link.c
    src/pairing_ui.c)
endif()

# The peripheral_uart chassis is shared; src/main.c is the app-init shim.
target_sources(app PRIVATE
  ${CMAKE_CURRENT_SOURCE_DIR}/../common/src/app_main.c
  src/main.c)
```

## Kconfig
```
#
# Copyright (c) 2018 Nordic Semiconductor
# Modifications Copyright © 2026 Stony Grey LLC.
#
# SPDX-License-Identifier: LicenseRef-Nordic-5-Clause
#
#
# Forked from NCS peripheral_uart; adds CONFIG_VERDIGRIS.
#

source "Kconfig.zephyr"

menu "Verdigris firmware"

config BT_NUS
	default y if !VERDIGRIS

config VERDIGRIS
	bool "Verdigris binary command/response protocol over NUS"
	default y
	select NANOPB
	help
	  When enabled, bytes received on the NUS RX characteristic are parsed
	  as length-prefixed protobuf Requests and answered with Responses on
	  the TX characteristic. When disabled, the firmware behaves exactly
	  like the stock peripheral_uart sample (BLE<->UART bridge).

config BT_NUS_THREAD_STACK_SIZE
	int "Thread stack size"
	default 1024
	help
	  Stack size used in each of the two threads

config BT_NUS_UART_BUFFER_SIZE
	int "UART payload buffer element size"
	default 40
	help
	  Size of the payload buffer in each RX and TX FIFO element

config BT_NUS_SECURITY_ENABLED
	bool "Security"
	default n if VERDIGRIS
	default y
	select BT_SMP
	help
	  Enable Bluetooth LE security (SMP) for the UART service. Off
	  under Verdigris: link security is Noise XX on the Verdigris
	  characteristics, which do not require ATT encryption. Leaving
	  the leftover NUS pairing UI enabled stole the same DK buttons
	  and could occupy the single BLE bond slot.

config BT_NUS_UART_RX_WAIT_TIME
	int "Timeout for UART RX complete event"
	default 50000
	help
	  Wait for RX complete event time in microseconds

config SETTINGS
	default y

config ZMS
	default y if (SOC_FLASH_NRF_RRAM || SOC_FLASH_NRF_MRAM)

config NVS
	default y if !(SOC_FLASH_NRF_RRAM || SOC_FLASH_NRF_MRAM)

endmenu
```

## prj.conf
```kconfig
#
# Copyright (c) 2018 Nordic Semiconductor
# Modifications Copyright © 2026 Stony Grey LLC.
#
# SPDX-License-Identifier: LicenseRef-Nordic-5-Clause
#
# Forked from NCS peripheral_uart prj.conf; Verdigris additions at the bottom.

# Enable the UART driver
CONFIG_UART_ASYNC_API=y
CONFIG_NRFX_UARTE=y
CONFIG_SERIAL=y

CONFIG_GPIO=y

# Make sure printk is printing to the UART console
CONFIG_CONSOLE=y
CONFIG_UART_CONSOLE=y

CONFIG_HEAP_MEM_POOL_SIZE=2048

CONFIG_BT=y
CONFIG_BT_PERIPHERAL=y
CONFIG_BT_DEVICE_NAME="Nordic_UART_Service"
CONFIG_BT_MAX_CONN=1
CONFIG_BT_MAX_PAIRED=1


# Enable bonding + custom NVS (vg/sk, vg/pin_*). Explicit so a reset
# cannot drop the handler backend.
CONFIG_BT_SETTINGS=y
CONFIG_SETTINGS=y
CONFIG_SETTINGS_NVS=y
CONFIG_FLASH=y
CONFIG_FLASH_PAGE_LAYOUT=y
CONFIG_FLASH_MAP=y

# Enable DK LED and Buttons library
CONFIG_DK_LIBRARY=y

CONFIG_SYSTEM_WORKQUEUE_STACK_SIZE=2048
# Config logger
CONFIG_LOG=y
CONFIG_USE_SEGGER_RTT=y
CONFIG_LOG_BACKEND_RTT=y
CONFIG_LOG_BACKEND_UART=n
CONFIG_LOG_PRINTK=n

CONFIG_ASSERT=y

# --- Verdigris additions ---

# Large ATT MTU + data length extension so multi-MTU frames move quickly.
CONFIG_BT_L2CAP_TX_MTU=247
CONFIG_BT_BUF_ACL_RX_SIZE=251
CONFIG_BT_BUF_ACL_TX_SIZE=251
CONFIG_BT_CTLR_DATA_LENGTH_MAX=251

# Floating point math (sqrt) on doubles.
CONFIG_FPU=y

# Accept ATT long (queued) writes from centrals that exceed the MTU per write
# (iOS/Windows may segment large characteristic writes this way).
CONFIG_BT_ATT_PREPARE_COUNT=8

# Advertised name is generated at boot ("Verdigris NNNN").
CONFIG_BT_DEVICE_NAME_DYNAMIC=y

# Noise is the link security. Do not also run leftover NUS SMP pairing
# (it is not required by the GATT permissions and used the same buttons).
CONFIG_BT_NUS_SECURITY_ENABLED=n

# --- Link security (Noise_XX_25519_AESGCM_SHA256 on PSA crypto) ---
CONFIG_PSA_CRYPTO=y
CONFIG_PSA_WANT_ALG_ECDH=y
CONFIG_PSA_WANT_ECC_MONTGOMERY_255=y
CONFIG_PSA_WANT_KEY_TYPE_ECC_KEY_PAIR_IMPORT=y
CONFIG_PSA_WANT_KEY_TYPE_ECC_KEY_PAIR_GENERATE=y
CONFIG_PSA_WANT_KEY_TYPE_ECC_KEY_PAIR_EXPORT=y
CONFIG_PSA_WANT_KEY_TYPE_ECC_PUBLIC_KEY=y
# Ed25519 verify for optional client endorsement (Oberon software).
CONFIG_PSA_WANT_ALG_PURE_EDDSA=y
CONFIG_PSA_WANT_ECC_TWISTED_EDWARDS_255=y
CONFIG_PSA_WANT_ALG_SHA_256=y
CONFIG_PSA_WANT_ALG_HMAC=y
CONFIG_PSA_WANT_ALG_GCM=y
CONFIG_PSA_WANT_KEY_TYPE_AES=y
CONFIG_PSA_WANT_AES_KEY_SIZE_256=y
CONFIG_MBEDTLS_HEAP_SIZE=16384

# Serial shell (vg info/unpair/confirm) on the J-Link VCOM port. Logs stay
# on RTT, so the shell owns the UART.
CONFIG_SHELL=y
```

## src/main.c
```c
/* Copyright © 2026 Stony Grey LLC.
 * SPDX-License-Identifier: MIT
 */

/* The peripheral_uart chassis is shared across every Verdigris app and is
 * in firmware/common/src/app_main.c; this shim supplies the app-specific
 * link initialization it calls after settings_load().
 */

#ifdef CONFIG_VERDIGRIS
#include "link_iface.h"
#include "link.h"
#include "pairing_ui.h"

void link_app_init(void)
{
	link_init();
	pairing_ui_init();
}
#endif
```

## src/link.h
```c
/* Copyright © 2026 Stony Grey LLC.
 * SPDX-License-Identifier: MIT
 */

/* BlueConnect link: Noise_XX_25519_AESGCM_SHA256 responder, pins, privilege.
 * The dispatcher-facing contract is link_iface.h; this header adds the
 * Noise app's ceremony and identity API. Framing and the Verdigris command
 * set are elsewhere. Button/LED/shell are pairing_ui.
 */
#ifndef LINK_H_
#define LINK_H_

#include "link_iface.h"

void link_init(void);

bool link_session_active(void);
bool link_is_paired(void);
const uint8_t *link_remote_key(void);

bool link_has_identity(void);
const uint8_t *link_static_public(void);
bool link_has_pin(enum link_privilege privilege);
const uint8_t *link_pin(enum link_privilege privilege);

/* Possession-gated clears (USB shell / button hold): the lock falls first
 * so the slot clear goes through. link_unpair clears both tiers.
 */
void link_unpair(void);
void link_clear_slot(enum link_privilege privilege);

/* USB provisioning: pin a client key into a tier slot and lock it — no
 * ceremony may replace or remotely clear a locked slot; `vg clear` and the
 * button hold clear pins and locks together (possession).
 */
bool link_set_pin(enum link_privilege privilege, const uint8_t key[32]);
bool link_slot_locked(enum link_privilege privilege);

/* How a slot came to be occupied. LINK_PRIV_ENROLL reports USB when the
 * enrollment key is present (it has no other way in).
 */
enum link_provenance {
	LINK_PROV_NONE = 0,
	LINK_PROV_USB,
	LINK_PROV_ENROLLED,
};
enum link_provenance link_slot_provenance(enum link_privilege privilege);

/* Rotates the device identity (vg/sk). Refuses when one exists unless
 * force — rotation makes every phone's pinned device key fail the pin check on its next
 * session, which is what the TOFU model requires.
 */
bool link_keygen(bool force);

/* Optional endorsement CA root (Ed25519 public). Empty = skip cert checks
 * (today's 0x5A handshake). Loaded = 0x5A still allowed; a cert blob is
 * verified fail-closed. Endorsement does not grant privilege.
 */
bool link_has_ca_root(void);
const uint8_t *link_ca_root(void);
bool link_set_ca_root(const uint8_t root[32]);
void link_clear_ca_root(void);
bool link_session_endorsed(void);

/* Pairing UI / shell: which window is armed (NONE if idle), and the
 * confirmation that was pressed (LOW or HIGH). USB confirm passes the
 * armed privilege so it always matches.
 */
enum link_privilege link_armed(void);
void link_confirm(enum link_privilege pressed);

#endif /* LINK_H_ */
```

## src/pairing_ui.c
```c
/* Copyright © 2026 Stony Grey LLC.
 * SPDX-License-Identifier: MIT
 */

#include "pairing_ui.h"
#include "verdigris.h"

#include <string.h>

#include <zephyr/kernel.h>
#include <zephyr/bluetooth/bluetooth.h>
#include <zephyr/logging/log.h>
#include <zephyr/shell/shell.h>

#include <dk_buttons_and_leds.h>

LOG_MODULE_REGISTER(pairing_ui);

#define UNPAIR_HOLD_MS 5000
#define WIPE_HOLD_MS 5000
#define PAIR_LED_LO DK_LED3
#define PAIR_LED_HI DK_LED4
#define PAIR_BTN_LO_MSK DK_BTN3_MSK
#define PAIR_BTN_HI_MSK DK_BTN4_MSK

static int64_t button_down_at;
static bool chord_armed;

static void pair_led(int led, bool on)
{
	dk_set_led(led, on);
}

static void pair_leds_off(void)
{
	dk_set_led(PAIR_LED_LO, 0);
	dk_set_led(PAIR_LED_HI, 0);
}

static void unpair_led_off(struct k_timer *timer)
{
	ARG_UNUSED(timer);
	pair_led(PAIR_LED_HI, false);
}

static K_TIMER_DEFINE(unpair_led_timer, unpair_led_off, NULL);

/* The wipe indication: LEDs 2 and 3 (dk indices 3/4) flash together three times so a factory
 * wipe is unmistakable (LED1/LED2 belong to the app state and the
 * connection; they stay out of it).
 */
#define SALUTE_TOGGLES 6
#define SALUTE_STEP_MS 150

static int salute_step;

static void salute_set(bool on)
{
	dk_set_led(DK_LED3, on);
	dk_set_led(DK_LED4, on);
}

static void salute_tick(struct k_timer *timer)
{
	if (salute_step >= SALUTE_TOGGLES) {
		k_timer_stop(timer);
		salute_set(false);
		return;
	}

	salute_set((salute_step % 2) == 0);
	salute_step++;
}

static K_TIMER_DEFINE(salute_timer, salute_tick, NULL);

static void salute_start(void)
{
	salute_step = 0;
	k_timer_start(&salute_timer, K_NO_WAIT, K_MSEC(SALUTE_STEP_MS));
}

void pairing_ui_window_begin(enum link_privilege privilege)
{
	ARG_UNUSED(privilege);
	pair_leds_off();
}

void pairing_ui_window_tick(int slice, bool high)
{
	int led = high ? PAIR_LED_HI : PAIR_LED_LO;

	pair_led(led, high ? (slice % 2) == 0 : (slice % 4) < 2);
}

void pairing_ui_window_end(void)
{
	pair_leds_off();
}

void pairing_ui_unpair_ack(void)
{
	pair_led(PAIR_LED_HI, true);
	k_timer_start(&unpair_led_timer, K_MSEC(500), K_NO_WAIT);
}

/* Factory wipe: pins, locks, and the device identity all fall; a fresh
 * identity is generated immediately so the link keeps working. Every
 * printed QR is invalidated and every pinned phone fails its pin check; that is the
 * point of the gesture.
 */
static void factory_wipe(void)
{
	link_unpair();
	link_clear_ca_root();
	(void)link_keygen(true);
	salute_start();
}

static void wipe_fire(struct k_work *work)
{
	ARG_UNUSED(work);
	factory_wipe();
}

static K_WORK_DELAYABLE_DEFINE(wipe_work, wipe_fire);

static void button_changed(uint32_t button_state, uint32_t has_changed)
{
	enum link_privilege needed = link_armed();
	uint32_t chord = PAIR_BTN_LO_MSK | PAIR_BTN_HI_MSK;

	/* Buttons 2+3 (dk indices 3/4) held together (no window armed) = factory wipe, triggered
	 * automatically at the 5 s mark while still held — the LED flashes starting
	 * are the cue to let go; no counting. Releasing early cancels. The
	 * chord claims both buttons and ignores their release.
	 */
	if ((button_state & chord) == chord) {
		if (needed == LINK_PRIV_NONE && !chord_armed) {
			chord_armed = true;
			k_work_schedule(&wipe_work, K_MSEC(WIPE_HOLD_MS));
		}
		button_down_at = 0;
		return;
	}
	if (chord_armed) {
		chord_armed = false;
		k_work_cancel_delayable(&wipe_work);
		return; /* ignore the chord's release */
	}

	if (has_changed & PAIR_BTN_LO_MSK) {
		if (button_state & PAIR_BTN_LO_MSK) {
			link_confirm(LINK_PRIV_LOW);
		}
	}

	if (has_changed & PAIR_BTN_HI_MSK) {
		if (button_state & PAIR_BTN_HI_MSK) {
			if (needed != LINK_PRIV_NONE) {
				/* A pairing window owns this press; do not
				 * treat a later release as an unpair hold.
				 */
				button_down_at = 0;
				link_confirm(LINK_PRIV_HIGH);
			} else {
				button_down_at = k_uptime_get();
			}
		} else if (needed == LINK_PRIV_NONE && button_down_at &&
			   (k_uptime_get() - button_down_at) >= UNPAIR_HOLD_MS) {
			link_unpair();
			pairing_ui_unpair_ack();
			button_down_at = 0;
		} else {
			button_down_at = 0;
		}
	}
}

void pairing_ui_init(void)
{
	dk_buttons_init(button_changed);
}

static void hex_line(const struct shell *sh, const char *label, const uint8_t *data, size_t len)
{
	static char hex[2 * LINK_KEY_LEN + 1];

	for (size_t i = 0; i < len && i < LINK_KEY_LEN; i++) {
		snprintk(&hex[2 * i], 3, "%02X", data[i]);
	}
	shell_print(sh, "%s%s", label, hex);
}

static const char *provenance_label(enum link_privilege tier)
{
	switch (link_slot_provenance(tier)) {
	case LINK_PROV_USB:
		return " (usb)";
	case LINK_PROV_ENROLLED:
		return " (enrolled)";
	default:
		return "";
	}
}

static int cmd_vg_info(const struct shell *sh, size_t argc, char **argv)
{
	ARG_UNUSED(argc);
	ARG_UNUSED(argv);

	const uint8_t *pub = link_static_public();
	const uint8_t *lo = link_pin(LINK_PRIV_LOW);
	const uint8_t *hi = link_pin(LINK_PRIV_HIGH);
	const uint8_t *en = link_pin(LINK_PRIV_ENROLL);

	shell_print(sh, "name: %s", bt_get_name());
	shell_print(sh, "identity: %s", link_has_identity() ? "present" : "missing");
	if (pub) {
		hex_line(sh, "pub: ", pub, LINK_KEY_LEN);
	}
	shell_print(sh, "paired: %s", link_is_paired() ? "yes" : "no");
	shell_print(sh, "low slot: %s%s", lo ? "pinned" : "empty",
		    provenance_label(LINK_PRIV_LOW));
	if (lo) {
		hex_line(sh, "  pin: ", lo, LINK_KEY_LEN);
	}
	shell_print(sh, "high slot: %s%s", hi ? "pinned" : "empty",
		    provenance_label(LINK_PRIV_HIGH));
	if (hi) {
		hex_line(sh, "  pin: ", hi, LINK_KEY_LEN);
	}
	shell_print(sh, "enrollment key: %s", en ? "pinned (usb)" : "empty");
	if (en) {
		hex_line(sh, "  key: ", en, LINK_KEY_LEN);
	}
	shell_print(sh, "ca root: %s", link_has_ca_root() ? "loaded" : "empty");
	if (link_has_ca_root()) {
		hex_line(sh, "  root: ", link_ca_root(), LINK_KEY_LEN);
	}
	if (link_session_active()) {
		shell_print(sh, "session: secure%s",
			    link_session_endorsed() ? " (endorsed)" : "");
	} else {
		shell_print(sh, "session: none");
	}
	return 0;
}

static enum link_privilege parse_tier(const char *arg)
{
	if (strcmp(arg, "lo") == 0 || strcmp(arg, "low") == 0) {
		return LINK_PRIV_LOW;
	}
	if (strcmp(arg, "hi") == 0 || strcmp(arg, "high") == 0) {
		return LINK_PRIV_HIGH;
	}
	if (strcmp(arg, "en") == 0 || strcmp(arg, "enroll") == 0) {
		return LINK_PRIV_ENROLL;
	}
	return LINK_PRIV_NONE;
}

static int cmd_vg_clear(const struct shell *sh, size_t argc, char **argv)
{
	if (argc == 2 && strcmp(argv[1], "all") != 0) {
		enum link_privilege tier = parse_tier(argv[1]);

		if (tier == LINK_PRIV_NONE) {
			shell_error(sh, "usage: vg clear [lo|hi|en|all]");
			return -EINVAL;
		}

		link_clear_slot(tier);
	} else {
		link_unpair();
	}

	shell_print(sh, "cleared");
	return 0;
}

static int cmd_vg_keygen(const struct shell *sh, size_t argc, char **argv)
{
	bool force = argc == 2 && strcmp(argv[1], "force") == 0;

	if (!link_keygen(force)) {
		shell_error(sh, link_has_identity()
			    ? "an identity exists; `vg keygen force` rotates it "
			      "(every pinned phone will fail its pin check)"
			    : "identity generation failed");
		return -EINVAL;
	}

	shell_print(sh, "rotated; read the public key back with `vg cred`");
	return 0;
}

static int cmd_vg_cred(const struct shell *sh, size_t argc, char **argv)
{
	ARG_UNUSED(argc);
	ARG_UNUSED(argv);

	const uint8_t *pub = link_static_public();

	if (!pub) {
		shell_error(sh, "no device identity; run `vg keygen`");
		return -ENOENT;
	}

	hex_line(sh, "", pub, LINK_KEY_LEN);
	return 0;
}

static int cmd_vg_confirm(const struct shell *sh, size_t argc, char **argv)
{
	ARG_UNUSED(argc);
	ARG_UNUSED(argv);

	enum link_privilege armed = link_armed();

	if (armed == LINK_PRIV_NONE) {
		shell_print(sh, "no pairing in progress");
		return 0;
	}

	link_confirm(armed);
	shell_print(sh, "confirmed");
	return 0;
}

static int cmd_vg_set(const struct shell *sh, size_t argc, char **argv)
{
	uint8_t key[LINK_KEY_LEN];
	enum link_privilege tier;
	size_t len = 0;

	if (argc != 3) {
		shell_error(sh, "usage: vg set <lo|hi|en> <hex32>");
		return -EINVAL;
	}

	tier = parse_tier(argv[1]);
	if (tier == LINK_PRIV_NONE) {
		shell_error(sh, "tier must be lo, hi, or en");
		return -EINVAL;
	}

	for (const char *c = argv[2]; *c != '\0'; c++, len++) {
		int hi_n, lo_n;

		if (len >= LINK_KEY_LEN) {
			break;
		}
		hi_n = *c;
		hi_n = hi_n >= '0' && hi_n <= '9' ? hi_n - '0'
		     : hi_n >= 'a' && hi_n <= 'f' ? hi_n - 'a' + 10
		     : hi_n >= 'A' && hi_n <= 'F' ? hi_n - 'A' + 10 : -1;
		c++;
		lo_n = *c;
		lo_n = lo_n >= '0' && lo_n <= '9' ? lo_n - '0'
		     : lo_n >= 'a' && lo_n <= 'f' ? lo_n - 'a' + 10
		     : lo_n >= 'A' && lo_n <= 'F' ? lo_n - 'A' + 10 : -1;
		if (hi_n < 0 || lo_n < 0) {
			shell_error(sh, "expected %u hex characters", 2 * LINK_KEY_LEN);
			return -EINVAL;
		}
		key[len] = (uint8_t)((hi_n << 4) | lo_n);
	}
	if (len != LINK_KEY_LEN || argv[2][2 * LINK_KEY_LEN] != '\0') {
		shell_error(sh, "expected %u hex characters", 2 * LINK_KEY_LEN);
		return -EINVAL;
	}

	if (!link_set_pin(tier, key)) {
		shell_error(sh, "pin rejected");
		return -EINVAL;
	}

	shell_print(sh, "pinned (%s, usb)", argv[1]);
	return 0;
}

static int parse_hex32(const struct shell *sh, const char *hex, uint8_t key[LINK_KEY_LEN])
{
	size_t len = 0;

	for (const char *c = hex; *c != '\0'; c++, len++) {
		int hi_n, lo_n;

		if (len >= LINK_KEY_LEN) {
			break;
		}
		hi_n = *c;
		hi_n = hi_n >= '0' && hi_n <= '9' ? hi_n - '0'
		     : hi_n >= 'a' && hi_n <= 'f' ? hi_n - 'a' + 10
		     : hi_n >= 'A' && hi_n <= 'F' ? hi_n - 'A' + 10 : -1;
		c++;
		lo_n = *c;
		lo_n = lo_n >= '0' && lo_n <= '9' ? lo_n - '0'
		     : lo_n >= 'a' && lo_n <= 'f' ? lo_n - 'a' + 10
		     : lo_n >= 'A' && lo_n <= 'F' ? lo_n - 'A' + 10 : -1;
		if (hi_n < 0 || lo_n < 0) {
			shell_error(sh, "expected %u hex characters", 2 * LINK_KEY_LEN);
			return -EINVAL;
		}
		key[len] = (uint8_t)((hi_n << 4) | lo_n);
	}
	if (len != LINK_KEY_LEN || hex[2 * LINK_KEY_LEN] != '\0') {
		shell_error(sh, "expected %u hex characters", 2 * LINK_KEY_LEN);
		return -EINVAL;
	}

	return 0;
}

static int cmd_vg_ca_root(const struct shell *sh, size_t argc, char **argv)
{
	uint8_t root[LINK_KEY_LEN];

	if (argc == 1) {
		if (!link_has_ca_root()) {
			shell_print(sh, "ca root: empty");
			return 0;
		}

		shell_print(sh, "ca root: loaded");
		hex_line(sh, "", link_ca_root(), LINK_KEY_LEN);
		return 0;
	}

	if (argc == 2 && strcmp(argv[1], "clear") == 0) {
		link_clear_ca_root();
		shell_print(sh, "cleared");
		return 0;
	}

	if (argc != 2) {
		shell_error(sh, "usage: vg ca-root [<hex32>|clear]");
		return -EINVAL;
	}

	if (parse_hex32(sh, argv[1], root) != 0) {
		return -EINVAL;
	}

	if (!link_set_ca_root(root)) {
		shell_error(sh, "root rejected");
		return -EINVAL;
	}

	shell_print(sh, "ca root loaded");
	return 0;
}

static int cmd_vg_wipe(const struct shell *sh, size_t argc, char **argv)
{
	ARG_UNUSED(argc);
	ARG_UNUSED(argv);

	factory_wipe();
	shell_print(sh, "wiped the stored keys; a fresh identity was generated");
	return 0;
}

SHELL_STATIC_SUBCMD_SET_CREATE(vg_cmds,
	SHELL_CMD(info, NULL, "Show link identity and pairing state", cmd_vg_info),
	SHELL_CMD(keygen, NULL, "Rotate the device identity: vg keygen [force]", cmd_vg_keygen),
	SHELL_CMD(cred, NULL, "Print the device public key as hex", cmd_vg_cred),
	SHELL_CMD(set, NULL, "Pin a client key over USB (locks the slot): vg set <lo|hi|en> <hex32>",
		  cmd_vg_set),
	SHELL_CMD(confirm, NULL, "Confirm the armed pairing (matching button)", cmd_vg_confirm),
	SHELL_CMD(clear, NULL, "Clear pin slot(s) and locks: vg clear [lo|hi|en|all]", cmd_vg_clear),
	SHELL_CMD(ca-root, NULL, "Show/set endorsement CA root: vg ca-root [<hex32>|clear]",
		  cmd_vg_ca_root),
	SHELL_CMD(wipe, NULL, "Factory wipe of the stored keys "
		  "(same as holding Buttons 2+3 for 5 s)", cmd_vg_wipe),
	SHELL_SUBCMD_SET_END);

SHELL_CMD_REGISTER(vg, &vg_cmds, "Verdigris link security", NULL);
```

## src/pairing_ui.h
```c
/* Copyright © 2026 Stony Grey LLC.
 * SPDX-License-Identifier: MIT
 */

/* Button 3 / LED 3 = low, Button 4 / LED 4 = high. Hold Button 4 5 s unpairs.
 * Serial `vg` is the same possession proof.
 */
#ifndef PAIRING_UI_H_
#define PAIRING_UI_H_

#include "link.h"

void pairing_ui_init(void);
void pairing_ui_window_begin(enum link_privilege privilege);
void pairing_ui_window_tick(int slice, bool high);
void pairing_ui_window_end(void);
void pairing_ui_unpair_ack(void);

#endif /* PAIRING_UI_H_ */
```
